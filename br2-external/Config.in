## br2-external/Config.in
```kconfig
menu "PlayOS packages"
    source "$BR2_EXTERNAL_PlayOS_PATH/package/playos-init/Config.in"
    source "$BR2_EXTERNAL_PlayOS_PATH/package/playos-platform-api/Config.in"
    source "$BR2_EXTERNAL_PlayOS_PATH/package/playos-runtime/Config.in"
    source "$BR2_EXTERNAL_PlayOS_PATH/package/playos-compositor/Config.in"
    source "$BR2_EXTERNAL_PlayOS_PATH/package/playos-shell/Config.in"
    source "$BR2_EXTERNAL_PlayOS_PATH/package/playos-raylib/Config.in"
    source "$BR2_EXTERNAL_PlayOS_PATH/package/playos-overlay/Config.in"
    source "$BR2_EXTERNAL_PlayOS_PATH/package/playos-installer/Config.in"
    source "$BR2_EXTERNAL_PlayOS_PATH/package/playos-samples/Config.in"
endmenu
```

## br2-external/package/playos-compositor/Config.in
```kconfig
config BR2_PACKAGE_PLAYOS_COMPOSITOR
	bool "playos-compositor"
	select BR2_PACKAGE_WLROOTS
	select BR2_PACKAGE_WAYLAND
	select BR2_PACKAGE_WAYLAND_PROTOCOLS
	select BR2_PACKAGE_LIBXKBCOMMON
	select BR2_PACKAGE_PIXMAN
	help
	  wlroots-based Wayland compositor. Permanently owns DRM/KMS,
	  manages all surfaces (shell, game, overlay), enforces the
	  first-frame rule, and intercepts the system button.

	  https://github.com/PlayOS-Foundation/playos-compositor
```

## br2-external/package/playos-init/Config.in
```kconfig
config BR2_PACKAGE_PLAYOS_INIT
	bool "playos-init"
	help
	  PlayOS init system — PID 1 supervisor.
	  Handles boot sequence, process supervision, game launch/kill,
	  and storage management.

	  https://github.com/PlayOS-Foundation/playos-refdistro
```

## br2-external/package/playos-installer/Config.in
```kconfig
config BR2_PACKAGE_PLAYOS_INSTALLER
	bool "playos-installer"
	help
	  Trusted one-shot internal-disk installer for PlayOS.

	  Booted by playos-init when the kernel command line carries
	  playos.mode=install. Repartitions the target NVMe drive with the
	  PlayOS GPT layout (ESP / playos-a / playos-b / misc / playos-data),
	  writes the system image and EFI stub, then powers off.
```

## br2-external/package/playos-lvgl/Config.in
```kconfig
config BR2_PACKAGE_PLAYOS_LVGL
	bool "playos-lvgl"
	help
	  LVGL v9 as a shared library (liblvgl.so), with the PlayOS lv_conf.h.
	  Used by the shell's UI spike (Sprint 22) and by the on-screen keyboard
	  in playos-overlay. Linked, not vendored per-component, so both trusted
	  UIs share one copy.

	  https://lvgl.io/
```

## br2-external/package/playos-net/Config.in
```kconfig
config BR2_PACKAGE_PLAYOS_NET
	bool "playos-net"
	depends on BR2_PACKAGE_WPA_SUPPLICANT
	help
	  PlayOS Wi-Fi bridge daemon (Sprint 16).

	  Owns wpa_supplicant's control socket and exposes scan / connect /
	  disconnect / status over the trusted control protocol on
	  /run/playos/net/bridge.sock. No D-Bus, and games cannot reach it
	  (see ADR-0012).
```

## br2-external/package/playos-overlay/Config.in
```kconfig
config BR2_PACKAGE_PLAYOS_OVERLAY
	bool "playos-overlay"
	help
	  Trusted in-game overlay rendered as a Raylib Wayland client.
	  Pre-spawned and hidden by playos-init; the compositor maps/unmaps
	  it in response to the reserved SYSTEM button. Shows the active
	  game, elapsed time, and system status, and offers Resume (A) and
	  Quit game (B) actions.
```

## br2-external/package/playos-platform-api/Config.in
```kconfig
config BR2_PACKAGE_PLAYOS_PLATFORM_API
	bool "playos-platform-api (libplayos)"
	help
	  Public libplayos C ABI — the only interface games may use.
	  Provides system, lifecycle, input, display, storage, audio,
	  power, and logging APIs.

	  https://github.com/PlayOS-Foundation/playos-platform-api
```

## br2-external/package/playos-raylib/Config.in
```kconfig
config BR2_PACKAGE_PLAYOS_RAYLIB
	bool "playos-raylib"
	select BR2_PACKAGE_ALSA_LIB
	help
	  Raylib 6.0 with the custom PlayOS Wayland/EGL/GLES2 backend,
	  installed as a shared library (libraylib.so.600) plus the
	  public headers (raylib.h, raymath.h, rlgl.h, rcamera.h).

	  Provides the PLATFORM_PLAYOS raylib backend as a reusable
	  package so samples and games can render via -lraylib.

	  https://github.com/raysan5/raylib
```

## br2-external/package/playos-recovery/Config.in
```kconfig
config BR2_PACKAGE_PLAYOS_RECOVERY
	bool "playos-recovery"
	select BR2_PACKAGE_WAYLAND
	select BR2_PACKAGE_WAYLAND_PROTOCOLS
	select BR2_PACKAGE_PLAYOS_RUNTIME
	help
	  GL-free recovery UI (Sprint 14, F3). Paints the recovery menu into a
	  wl_shm buffer and rasterises its text in software, so recovery works
	  even when the GPU/GL stack (and with it playos-shell) cannot start.
```

## br2-external/package/playos-runtime/Config.in
```kconfig
config BR2_PACKAGE_PLAYOS_RUNTIME
	bool "playos-runtime"
	help
	  Internal runtime IPC layer — Unix domain socket protocol
	  and Wayland protocol XML connecting playos-init,
	  playos-compositor, playos-shell, and playos-overlay.

	  https://github.com/PlayOS-Foundation/playos-runtime
```

## br2-external/package/playos-samples/Config.in
```kconfig
config BR2_PACKAGE_PLAYOS_SAMPLES
	bool "playos-samples"
	depends on BR2_PACKAGE_PLAYOS_PLATFORM_API
	select BR2_PACKAGE_PLAYOS_RAYLIB
	help
	  Reference sample games installed under /data/games.

	  Cross-compiles the four sample binaries against libplayos (and,
	  for rotating-squares, libraylib) and installs each one's binary,
	  manifest, and icon into the library layout the shell scans on
	  startup.

	  https://github.com/PlayOS-Foundation/playos-samples
```

## br2-external/package/playos-shell/Config.in
```kconfig
config BR2_PACKAGE_PLAYOS_SHELL
	bool "playos-shell"
	help
	  Controller-first, fullscreen Raylib shell application.
	  Home screen, game library, settings, and system overlay trigger.
	  Always alive as a trusted Wayland client.

	  https://github.com/PlayOS-Foundation/playos-shell

config BR2_PACKAGE_PLAYOS_SHELL_LVGL_SPIKE
	bool "LVGL widget layer (Sprint 22 spike, experimental)"
	help
	  Build the shell with LVGL v9 as a widget layer over raylib: raylib keeps the
	  window/GL/vsync and LVGL draws into a texture (ADR-0013, Path 1). The shell
	  still runs its normal UI unless PLAYOS_SHELL_LVGL_SPIKE=1 is set in the
	  environment, so this changes nothing by default.
	
	  Experimental: not for release images.
```
